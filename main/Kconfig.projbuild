## main/Kconfig.projbuild
```kconfig
menu "Example Configuration"
    config EXAMPLE_USED_LDO_CHAN_ID
        int "example used LDO channel ID"
        default 3
        help
            Example used LDO channel ID, you may check datasheet to know more details.

    config EXAMPLE_USED_LDO_VOLTAGE_MV
        int "example used LDO voltage in mV"
        default 2500
        range 0 3300
        help
            Example used LDO voltage, in mV

    choice EXAMPLE_MIPI_CSI_HRES_CHOICE
        bool "Set MIPI CSI horizontal resolution"
        default EXAMPLE_MIPI_CSI_HRES_1024

        config EXAMPLE_MIPI_CSI_HRES_800
            bool "800"
        config EXAMPLE_MIPI_CSI_HRES_1024
            bool "1024"
    endchoice

    config EXAMPLE_MIPI_CSI_HRES
        int
        default 800 if EXAMPLE_MIPI_CSI_HRES_800
        default 1024 if EXAMPLE_MIPI_CSI_HRES_1024

    choice EXAMPLE_MIPI_CSI_VRES_CHOICE
        bool "Set MIPI CSI vertical resolution"
        default EXAMPLE_MIPI_CSI_VRES_600

        config EXAMPLE_MIPI_CSI_VRES_600
            bool "600"
        config EXAMPLE_MIPI_CSI_VRES_640
            bool "640"
        config EXAMPLE_MIPI_CSI_VRES_800
            bool "800"
        config EXAMPLE_MIPI_CSI_VRES_1280
            bool "1280"
    endchoice

    config EXAMPLE_MIPI_CSI_VRES
        int
        default 600 if EXAMPLE_MIPI_CSI_VRES_600
        default 640 if EXAMPLE_MIPI_CSI_VRES_640
        default 800 if EXAMPLE_MIPI_CSI_VRES_800
        default 1280 if EXAMPLE_MIPI_CSI_VRES_1280

    config ESP_WIFI_SSID
        string "WiFi SSID"
        default "myssid"
        help
            SSID (network name) for the example to connect to.

    config ESP_WIFI_PASSWORD
        string "WiFi Password"
        default "mypassword"
        help
            WiFi password (WPA or WPA2) for the example to use.

    choice ESP_WIFI_SAE_MODE
        prompt "WPA3 SAE mode selection"
        default ESP_STATION_EXAMPLE_WPA3_SAE_PWE_BOTH
        help
            Select mode for SAE as Hunt and Peck, H2E or both.
        config ESP_STATION_EXAMPLE_WPA3_SAE_PWE_HUNT_AND_PECK
            bool "HUNT AND PECK"
        config ESP_STATION_EXAMPLE_WPA3_SAE_PWE_HASH_TO_ELEMENT
            bool "H2E"
            depends on ESP_WIFI_ENABLE_SAE_H2E
        config ESP_STATION_EXAMPLE_WPA3_SAE_PWE_BOTH
            bool "BOTH"
            depends on ESP_WIFI_ENABLE_SAE_H2E
    endchoice

    config ESP_WIFI_PW_ID
        string "PASSWORD IDENTIFIER"
        depends on  ESP_STATION_EXAMPLE_WPA3_SAE_PWE_HASH_TO_ELEMENT|| ESP_STATION_EXAMPLE_WPA3_SAE_PWE_BOTH
        default ""
        help
            password identifier for SAE H2E

    config ESP_MAXIMUM_RETRY
        int "Maximum retry"
        default 5
        help
            Set the Maximum retry to avoid station reconnecting to the AP unlimited when the AP is really inexistent.

    choice ESP_WIFI_SCAN_AUTH_MODE_THRESHOLD
        prompt "WiFi Scan auth mode threshold"
        default ESP_WIFI_AUTH_WPA2_PSK
        help
            The weakest authmode to accept in the scan mode.
            This value defaults to ESP_WIFI_AUTH_WPA2_PSK in case password is present and ESP_WIFI_AUTH_OPEN is used.
            Please select ESP_WIFI_AUTH_WEP/ESP_WIFI_AUTH_WPA_PSK in case AP is operating in WEP/WPA mode.

        config ESP_WIFI_AUTH_OPEN
            bool "OPEN"
        config ESP_WIFI_AUTH_WEP
            bool "WEP"
        config ESP_WIFI_AUTH_WPA_PSK
            bool "WPA PSK"
        config ESP_WIFI_AUTH_WPA2_PSK
            bool "WPA2 PSK"
        config ESP_WIFI_AUTH_WPA_WPA2_PSK
            bool "WPA/WPA2 PSK"
        config ESP_WIFI_AUTH_WPA3_PSK
            bool "WPA3 PSK"
        config ESP_WIFI_AUTH_WPA2_WPA3_PSK
            bool "WPA2/WPA3 PSK"
        config ESP_WIFI_AUTH_WAPI_PSK
            bool "WAPI PSK"
    endchoice
endmenu
```

## sdkconfig.defaults
```kconfig
CONFIG_IDF_TARGET="esp32p4"
CONFIG_SPIRAM=y
CONFIG_IDF_EXPERIMENTAL_FEATURES=y
CONFIG_SPIRAM_SPEED_200M=y
CONFIG_CAMERA_SC2336=y
CONFIG_CAMERA_OV5647=y

# HTTP Server Konfiguration
CONFIG_HTTPD_MAX_REQ_HDR_LEN=1024
CONFIG_HTTPD_MAX_URI_LEN=512
```
